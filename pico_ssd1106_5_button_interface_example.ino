//OLED SSD1106 Support
#include <U8g2lib.h>

U8G2_SH1106_128X64_NONAME_F_HW_I2C u8g2(U8G2_R0);

//
int x = 128; // Start off-screen right
int contrast = 0;
const int buttonPins[] = {2, 3, 6, 7, 8};
bool buttonStates[5];
bool ledState = false;

// 'oledlogo', 128x64px
const unsigned char epd_bitmap_oledlogo [] PROGMEM = {
	0xff, 0x31, 0x00, 0x00, 0x20, 0x00, 0x00, 0x00, 0x00, 0x00, 0x00, 0x00, 0x00, 0x00, 0x00, 0x00, 
	0x5f, 0xc7, 0x01, 0x00, 0x00, 0x00, 0x00, 0x00, 0x00, 0x20, 0x00, 0x00, 0x00, 0x60, 0x00, 0x00, 
	0x2b, 0xff, 0x0d, 0x00, 0x00, 0x02, 0x00, 0x00, 0x00, 0x00, 0x00, 0x00, 0x00, 0x60, 0x00, 0x00, 
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	0x00, 0x00, 0x00, 0x08, 0x00, 0x00, 0x00, 0x00, 0x00, 0x00, 0x00, 0x00, 0x00, 0x00, 0x00, 0x00
};


void setup() {
  // put your setup code here, to run once:
  // Initalize OLED SCREEN
  u8g2.begin();
  // Set Brightness to Max 0-255
  u8g2.setContrast(255);
  //Set button pins to input
  for(int i=0;i<5;i++){
    pinMode(buttonPins[i],INPUT_PULLUP);
  }
  //Show boot logo for 6.6 seconds while modifying brightness.
  u8g2.clearBuffer();
	u8g2.drawXBMP(0, 0, 128, 64, epd_bitmap_oledlogo);
  u8g2.sendBuffer();
  // Pulse contrast from 0 to 255 over 3 seconds
  unsigned long startTime = millis();
  int contrast = 0;
  int direction = 5; // Step size

  while (millis() - startTime < 6600) {
    u8g2.setContrast(contrast);
    contrast += direction;

    // Reverse direction at bounds
    if (contrast >= 255 || contrast <= 0) {
      direction = -direction;
    }
      delay(20); // Controls pulse speed
    }
    // Set Brightness to Max 0-255
    u8g2.setContrast(255);
    delay(1000); // Hold at full contrast for a moment 1 second
  }

void loop() {
  // put your main code here, to run repeatedly:
  // Read button status
  for(int i = 0;i<5;i++){
    buttonStates[i]=digitalRead(buttonPins[i])==LOW;
  }
  // Clear screen
  u8g2.clearBuffer();
  // Print button status to screen
  for(int i = 0;i<5;i++){
    // Small Font
    u8g2.setFont(u8g2_font_6x10_tf);
    // Line Positioning
    u8g2.setCursor(0,12+i*12);
    // Print which button pressed to screen
    u8g2.print("GP");
    u8g2.print(buttonPins[i]);
    u8g2.print(": ");
    u8g2.print(buttonStates[i] ? "ON" : "OFF");
  }
  // Update screen
  u8g2.sendBuffer();

  // Delay between reads
  delay(100);

}
